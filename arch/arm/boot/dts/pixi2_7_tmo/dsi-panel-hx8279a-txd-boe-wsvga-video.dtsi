/* Copyright (c) 2014, The Linux Foundation. All rights reserved.
 *
 * This program is free software; you can redistribute it and/or modify
 * it under the terms of the GNU General Public License version 2 and
 * only version 2 as published by the Free Software Foundation.
 *
 * This program is distributed in the hope that it will be useful,
 * but WITHOUT ANY WARRANTY; without even the implied warranty of
 * MERCHANTABILITY or FITNESS FOR A PARTICULAR PURPOSE.  See the
 * GNU General Public License for more details.
 */

/*---------------------------------------------------------------------------
 * This file is autogenerated file using gcdb parser. Please do not edit it.
 * Update input XML file to add a new entry or update variable in this file
 * VERSION = "1.0"
 *---------------------------------------------------------------------------*/
&mdss_mdp {
	dsi_hx8279a_txd_boe_wsvga_video: qcom,mdss_dsi_hx8279a_txd_boe_wsvga_video {
		qcom,mdss-dsi-panel-name = "HX8279A TXD BOE wsvga video mode dsi panel";
		qcom,mdss-dsi-panel-controller = <&mdss_dsi0>;
		qcom,mdss-dsi-panel-type = "dsi_video_mode";
		qcom,mdss-dsi-panel-destination = "display_1";
		qcom,mdss-dsi-panel-framerate = <60>;
		qcom,mdss-dsi-virtual-channel-id = <0>;
		qcom,mdss-dsi-stream = <0>;
		qcom,mdss-dsi-panel-width = <600>;
		qcom,mdss-dsi-panel-height = <1024>;
		qcom,mdss-dsi-h-front-porch = <100>;
		qcom,mdss-dsi-h-back-porch = <36>;
		qcom,mdss-dsi-h-pulse-width = <24>;
		qcom,mdss-dsi-h-sync-skew = <0>;
		qcom,mdss-dsi-v-back-porch = <8>;
		qcom,mdss-dsi-v-front-porch = <22>;
		qcom,mdss-dsi-v-pulse-width = <2>;
		qcom,mdss-dsi-h-left-border = <0>;
		qcom,mdss-dsi-h-right-border = <0>;
		qcom,mdss-dsi-v-top-border = <0>;
		qcom,mdss-dsi-v-bottom-border = <0>;
		qcom,mdss-dsi-bpp = <24>;
		qcom,mdss-dsi-color-order = "rgb_swap_rgb";
		qcom,mdss-dsi-underflow-color = <0xff>;
		qcom,mdss-dsi-border-color = <0>;
		qcom,mdss-dsi-lp11-init = <1>;
		qcom,mdss-dsi-init-delay-us = <50000>;
		qcom,mdss-dsi-on-command = [
			15 01 00 00 00 00 02 B0 00
			15 01 00 00 00 00 02 BA A4
			15 01 00 00 00 00 02 BD 6C
			15 01 00 00 00 00 02 BE 00
			15 01 00 00 00 00 02 BF 19
			15 01 00 00 00 00 02 C0 10
			15 01 00 00 00 00 02 C1 78
			15 01 00 00 00 00 02 C2 5C
			15 01 00 00 00 00 02 C3 E8
			15 01 00 00 00 00 02 C4 73
			15 01 00 00 00 00 02 C5 05
			15 01 00 00 00 00 02 C6 02
			15 01 00 00 00 00 02 C7 05
			15 01 00 00 00 00 02 C8 03
			15 01 00 00 00 00 02 C9 18
			15 01 00 00 00 00 02 CA 00
			15 01 00 00 00 00 02 CB 00
			15 01 00 00 00 00 02 B0 01
			15 01 00 00 00 00 02 B1 01
			15 01 00 00 00 00 02 B2 26
			15 01 00 00 00 00 02 B3 55
			15 01 00 00 00 00 02 B4 A1
			15 01 00 00 00 00 02 B5 ce
			15 01 00 00 00 00 02 B6 11
			15 01 00 00 00 00 02 B7 54
			15 01 00 00 00 00 02 B8 7a
			15 01 00 00 00 00 02 B9 d2
			15 01 00 00 00 00 02 BA 06
			15 01 00 00 00 00 02 BB 3a
			15 01 00 00 00 00 02 BC 74
			15 01 00 00 00 00 02 BD ad
			15 01 00 00 00 00 02 BE cd
			15 01 00 00 00 00 02 BF 02
			15 01 00 00 00 00 02 C0 66
			15 01 00 00 00 00 02 C1 8D
			15 01 00 00 00 00 02 C2 00
			15 01 00 00 00 00 02 C3 15
			15 01 00 00 00 00 02 C4 6a
			15 01 00 00 00 00 02 C5 AF
			15 01 00 00 00 00 02 C6 03
			15 01 00 00 00 00 02 C7 00
			15 01 00 00 00 00 02 C8 26
			15 01 00 00 00 00 02 C9 55
			15 01 00 00 00 00 02 CA A1
			15 01 00 00 00 00 02 CB ce
			15 01 00 00 00 00 02 CC 11
			15 01 00 00 00 00 02 CD 54
			15 01 00 00 00 00 02 CE 7a
			15 01 00 00 00 00 02 CF d2
			15 01 00 00 00 00 02 D0 06
			15 01 00 00 00 00 02 D1 3a
			15 01 00 00 00 00 02 D2 74
			15 01 00 00 00 00 02 D3 ad
			15 01 00 00 00 00 02 D4 cd
			15 01 00 00 00 00 02 D5 02
			15 01 00 00 00 00 02 D6 66
			15 01 00 00 00 00 02 D7 8D
			15 01 00 00 00 00 02 D8 00
			15 01 00 00 00 00 02 D9 15
			15 01 00 00 00 00 02 DA 6A
			15 01 00 00 00 00 02 DB AF
			15 01 00 00 00 00 02 DC 03
			15 01 00 00 00 00 02 DD 00
			15 01 00 00 00 00 02 DE 26
			15 01 00 00 00 00 02 DF 55
			15 01 00 00 00 00 02 E0 A1
			15 01 00 00 00 00 02 E1 ce
			15 01 00 00 00 00 02 E2 11
			15 01 00 00 00 00 02 E3 54
			15 01 00 00 00 00 02 E4 7a
			15 01 00 00 00 00 02 E5 d2
			15 01 00 00 00 00 02 E6 06
			15 01 00 00 00 00 02 E7 3a
			15 01 00 00 00 00 02 E8 74
			15 01 00 00 00 00 02 E9 ad
			15 01 00 00 00 00 02 EA cd
			15 01 00 00 00 00 02 EB 02
			15 01 00 00 00 00 02 EC 66
			15 01 00 00 00 00 02 ED 8D
			15 01 00 00 00 00 02 EE 00
			15 01 00 00 00 00 02 EF 15
			15 01 00 00 00 00 02 F0 6A
			15 01 00 00 00 00 02 F1 AF
			15 01 00 00 00 00 02 F2 03
			15 01 00 00 00 00 02 B0 02
			15 01 00 00 00 00 02 B1 01
			15 01 00 00 00 00 02 B2 26
			15 01 00 00 00 00 02 B3 55
			15 01 00 00 00 00 02 B4 A1
			15 01 00 00 00 00 02 B5 ce
			15 01 00 00 00 00 02 B6 11
			15 01 00 00 00 00 02 B7 54
			15 01 00 00 00 00 02 B8 7a
			15 01 00 00 00 00 02 B9 d2
			15 01 00 00 00 00 02 BA 06
			15 01 00 00 00 00 02 BB 3a
			15 01 00 00 00 00 02 BC 74
			15 01 00 00 00 00 02 BD ad
			15 01 00 00 00 00 02 BE cd
			15 01 00 00 00 00 02 BF 02
			15 01 00 00 00 00 02 C0 66
			15 01 00 00 00 00 02 C1 8D
			15 01 00 00 00 00 02 C2 00
			15 01 00 00 00 00 02 C3 15
			15 01 00 00 00 00 02 C4 6a
			15 01 00 00 00 00 02 C5 AF
			15 01 00 00 00 00 02 C6 03
			15 01 00 00 00 00 02 C7 00
			15 01 00 00 00 00 02 C8 26
			15 01 00 00 00 00 02 C9 55
			15 01 00 00 00 00 02 CA A1
			15 01 00 00 00 00 02 CB ce
			15 01 00 00 00 00 02 CC 11
			15 01 00 00 00 00 02 CD 54
			15 01 00 00 00 00 02 CE 7a
			15 01 00 00 00 00 02 CF d2
			15 01 00 00 00 00 02 D0 06
			15 01 00 00 00 00 02 D1 3a
			15 01 00 00 00 00 02 D2 74
			15 01 00 00 00 00 02 D3 ad
			15 01 00 00 00 00 02 D4 cd
			15 01 00 00 00 00 02 D5 02
			15 01 00 00 00 00 02 D6 66
			15 01 00 00 00 00 02 D7 8D
			15 01 00 00 00 00 02 D8 00
			15 01 00 00 00 00 02 D9 15
			15 01 00 00 00 00 02 DA 6A
			15 01 00 00 00 00 02 DB AF
			15 01 00 00 00 00 02 DC 03
			15 01 00 00 00 00 02 DD 00
			15 01 00 00 00 00 02 DE 26
			15 01 00 00 00 00 02 DF 55
			15 01 00 00 00 00 02 E0 A1
			15 01 00 00 00 00 02 E1 ce
			15 01 00 00 00 00 02 E2 11
			15 01 00 00 00 00 02 E3 54
			15 01 00 00 00 00 02 E4 7a
			15 01 00 00 00 00 02 E5 d2
			15 01 00 00 00 00 02 E6 06
			15 01 00 00 00 00 02 E7 3a
			15 01 00 00 00 00 02 E8 74
			15 01 00 00 00 00 02 E9 ad
			15 01 00 00 00 00 02 EA cd
			15 01 00 00 00 00 02 EB 02
			15 01 00 00 00 00 02 EC 66
			15 01 00 00 00 00 02 ED 8D
			15 01 00 00 00 00 02 EE 00
			15 01 00 00 00 00 02 EF 15
			15 01 00 00 00 00 02 F0 6A
			15 01 00 00 00 00 02 F1 AF
			15 01 00 00 00 00 02 F2 03
			15 01 00 00 00 00 02 B0 03
			15 01 00 00 00 00 02 C0 40
			15 01 00 00 00 00 02 C1 10
			15 01 00 00 00 00 02 C4 2F
			15 01 00 00 00 00 02 C5 9E
			15 01 00 00 00 00 02 C8 41
			15 01 00 00 00 00 02 C9 61
			15 01 00 00 00 00 02 CA 01
			15 01 00 00 00 00 02 CB 00
			15 01 00 00 00 00 02 DC 01
			15 01 00 00 00 00 02 DD 07
			15 01 00 00 00 00 02 DE 05
			15 01 00 00 00 00 02 DF 00
			15 01 00 00 00 00 02 E0 00
			15 01 00 00 00 00 02 E1 00
			15 01 00 00 00 00 02 E2 00
			15 01 00 00 00 00 02 E3 00
			15 01 00 00 00 00 02 E4 00
			15 01 00 00 00 00 02 E5 00
			15 01 00 00 00 00 02 E6 00
			15 01 00 00 00 00 02 E7 00
			15 01 00 00 00 00 02 E8 00
			15 01 00 00 00 00 02 E9 00
			15 01 00 00 00 00 02 EA 00
			15 01 00 00 00 00 02 EB 00
			15 01 00 00 00 00 02 EC 02
			15 01 00 00 00 00 02 ED 08
			15 01 00 00 00 00 02 EE 06
			15 01 00 00 00 00 02 EF 00
			15 01 00 00 00 00 02 F0 00
			15 01 00 00 00 00 02 F1 00
			15 01 00 00 00 00 02 F2 00
			15 01 00 00 00 00 02 F3 00
			15 01 00 00 00 00 02 F4 00
			15 01 00 00 00 00 02 F5 00
			15 01 00 00 00 00 02 F6 00
			15 01 00 00 00 00 02 F7 00
			15 01 00 00 00 00 02 F8 00
			15 01 00 00 00 00 02 F9 00
			15 01 00 00 00 00 02 FA 00
			15 01 00 00 00 00 02 FB 00
			15 01 00 00 00 00 02 B0 05
			15 01 00 00 00 00 02 B3 52
			15 01 00 00 00 00 02 B0 06
			15 01 00 00 00 00 02 CA 0B
			15 01 00 00 00 00 02 B0 06
			15 01 00 00 00 00 02 B8 A5
			15 01 00 00 00 00 02 C0 A5
			15 01 00 00 00 00 02 B5 0F
			15 01 00 00 00 00 02 C7 1F
			15 01 00 00 00 00 02 CE 4F
			15 01 00 00 00 00 02 B8 5A
			15 01 00 00 00 00 02 C0 5A
			15 01 00 00 00 00 02 B0 03
			15 01 00 00 00 00 02 B2 A5
			15 01 00 00 00 00 02 B3 04
			15 01 00 00 00 00 02 B0 0F
			15 01 00 00 00 00 02 35 01
			05 01 00 00 80 00 02 11 00
			05 01 00 00 00 00 02 29 00];
		qcom,mdss-dsi-off-command = [05 01 00 00 32 00 02 28 00
					05 01 00 00 78 00 02 10 00];
		qcom,mdss-dsi-on-command-state = "dsi_lp_mode";
		qcom,mdss-dsi-off-command-state = "dsi_lp_mode";
		qcom,mdss-dsi-h-sync-pulse = <1>;
		qcom,mdss-dsi-traffic-mode = "burst_mode";
		qcom,mdss-dsi-lane-map = "lane_map_0123";
		qcom,mdss-dsi-bllp-eof-power-mode;
		qcom,mdss-dsi-bllp-power-mode;
		qcom,mdss-dsi-lane-0-state;
		qcom,mdss-dsi-lane-1-state;
		qcom,mdss-dsi-lane-2-state;
		qcom,mdss-dsi-lane-3-state;
		qcom,mdss-dsi-panel-timings = [5F 12 0A 00 32 34 10 16 0F 03 04 00];
		qcom,mdss-dsi-t-clk-post = <0x05>;
		qcom,mdss-dsi-t-clk-pre = <0x15>;
		qcom,mdss-dsi-bl-min-level = <8>;
		qcom,mdss-dsi-bl-max-level = <255>;
		qcom,mdss-dsi-dma-trigger = "trigger_sw";
		qcom,mdss-dsi-mdp-trigger = "none";
		qcom,mdss-dsi-bl-pmic-control-type = "bl_ctrl_pwm";
		qcom,mdss-dsi-bl-pmic-pwm-frequency = <33>;
		qcom,mdss-dsi-bl-pmic-bank-select = <0>;
		qcom,mdss-dsi-pwm-gpio = <&pm8916_mpps 4 0>;
		qcom,mdss-dsi-reset-sequence = <0 20>, <0 0>, <1 200>;
		qcom,cont-splash-enabled;
/*[FEATURE]-Add-BEGIN by TCTSZ.yaohui.zeng, 2015/07/06, enable ESD check*/
		qcom,esd-check-enabled;
/*[FEATURE]-Add-END by TCTSZ.yaohui.zeng, 2015/07/06*/
	};
};
